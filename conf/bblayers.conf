## conf/bblayers.conf
```bitbake
# POKY_BBLAYERS_CONF_VERSION is increased each time build/conf/bblayers.conf
# changes incompatibly
POKY_BBLAYERS_CONF_VERSION = "2"

BBPATH = "${TOPDIR}"
BBFILES ?= ""

BBLAYERS ?= " \
  /home/son/Projects/yocto-raspi4/poky/meta \
  /home/son/Projects/yocto-raspi4/poky/meta-poky \
  /home/son/Projects/yocto-raspi4/poky/meta-yocto-bsp \
  /home/son/Projects/yocto-raspi4/meta-raspberrypi \
  /home/son/Projects/yocto-raspi4/meta-openembedded/meta-oe \
  /home/son/Projects/yocto-raspi4/meta-openembedded/meta-python \
  /home/son/Projects/yocto-raspi4/meta-openembedded/meta-networking \
  /home/son/Projects/yocto-raspi4/meta-openembedded/meta-filesystems \
  "
```
